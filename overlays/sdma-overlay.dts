/dts-v1/;
/plugin/;

/ {
	  compatible = "brcm,bcm2837";

    fragment@0 {
        target = <&soc>;
        __overlay__ {
            sdma_m2m: sdma_m2m {
              compatible = "arrow,sdma_m2m";
            };
        };
    };
};
