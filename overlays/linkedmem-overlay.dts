/dts-v1/;
/plugin/;

/ {
	  compatible = "brcm,bcm2837";

    fragment@0 {
        target = <&soc>;
        __overlay__ {
            linked_memory {
              compatible = "arrow,memory";
            };
        };
    };
};
